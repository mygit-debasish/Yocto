## build/conf/bblayers.conf
```bitbake
# POKY_BBLAYERS_CONF_VERSION is increased each time build/conf/bblayers.conf
# changes incompatibly
POKY_BBLAYERS_CONF_VERSION = "2"

BBPATH = "${TOPDIR}"
BBFILES ?= ""

BBLAYERS ?= " \
  /home/debasish/Yocto/poky/meta \
  /home/debasish/Yocto/poky/meta-poky \
  /home/debasish/Yocto/poky/meta-yocto-bsp \
  /home/debasish/Yocto/poky/meta-helloworld \
  /home/debasish/Yocto/poky/meta-openembedded/meta-oe \
  /home/debasish/Yocto/poky/meta-qt5 \
  "
```
